## components/wifi_sta/Kconfig
```kconfig
menu "Wi-Fi Configuration"

config WIFI_SSID
    string "Wi-Fi SSID"
    default "MyWiFi"

config WIFI_PASSWORD
    string "Wi-Fi Password"
    default "MyPassword"

endmenu
```

## main/Kconfig.projbuild
```kconfig
menu "MQTT Configuration"

config MQTT_CHANNEL_ID
    string "ThingSpeak Channel ID"
    default ""

config MQTT_CLIENT_ID
    string "MQTT Client ID"
    default ""

config MQTT_USERNAME
    string "MQTT Username"
    default ""

config MQTT_PASSWORD
    string "MQTT Password (API Key)"
    default ""

endmenu
```
